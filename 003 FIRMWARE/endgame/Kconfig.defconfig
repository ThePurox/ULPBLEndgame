## 003 FIRMWARE/endgame/Kconfig.defconfig
```kconfig
# Copyright (c) 2021 The ZMK Contributors
# SPDX-License-Identifier: MIT

if SHIELD_ENDGAME

config ZMK_KEYBOARD_NAME
    default "The ENDGAME"

endif
```

## 003 FIRMWARE/endgame/Kconfig.shield
```kconfig
# Copyright (c) 2021 The ZMK Contributors
# SPDX-License-Identifier: MIT

config SHIELD_ENDGAME
    def_bool $(shields_list_contains,endgame)
```
